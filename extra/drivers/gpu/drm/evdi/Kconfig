## extra/drivers/gpu/drm/evdi/Kconfig
```kconfig
#
# Copyright (c) 2015 - 2019 DisplayLink (UK) Ltd.
#
# This file is subject to the terms and conditions of the GNU General Public
# License v2. See the file COPYING in the main directory of this archive for
# more details.
#

config DRM_LINDROID_EVDI
	tristate "Extensible Virtual Display Interface"
	depends on DRM
	select DRM_KMS_HELPER
	help
		This is a KMS interface driver allowing user-space programs to
		register a virtual display (that imitates physical monitor) and
		retrieve contents (as a frame buffer) that system renders on it.
		Say M/Y to add support for these devices via DRM/KMS interfaces.

config DRM_LINDROID_EVDI_KUNIT_TEST
	tristate "KUnit tests for evdi" if !KUNIT_ALL_TESTS
		depends on DRM_LINDROID_EVDI && KUNIT
		default KUNIT_ALL_TESTS
	help
		KUnit tests for lindroid evdi DRM module.
		This option is useful for kernel developers.
		Please remember to provide tests for code you add.

		If in doubt, say "N".
```
